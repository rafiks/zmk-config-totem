## config/west.yml
```yaml
manifest:
  remotes:
    - name: zmkfirmware
      url-base: https://github.com/zmkfirmware
    - name: rafiks
      url-base: https://github.com/rafiks
  projects:
    - name: zmk
      remote: zmkfirmware
      revision: main
      import: app/west.yml
    - name: zmk-totem-module
      remote: rafiks
      revision: main
    - name: prospector-zmk-module
      remote: rafiks
      revision: feat/new-status-screens
  self:
    path: config
```
